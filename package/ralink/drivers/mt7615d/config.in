## package/ralink/drivers/mt7615d/config.in
```kconfig
if PACKAGE_kmod-mt7615d

config RALINK_SUPPORT_OPENWRT
	bool
	default y
	depends on PACKAGE_kmod-mt7615d

config RALINK_WIFI_DRIVER
	bool
	default y
	depends on PACKAGE_kmod-mt7615d
	select RALINK_WIFI_MT_MAC
	select RALINK_MT_MAC
	select RALINK_FIRST_IF_MT7615E
	#select RALINK_CHIP_MT7622
	#select RALINK_CHIP_MT7626
	#select RALINK_SECOND_IF_MT7615E
	#select RALINK_THIRD_IF_MT7615E
	#select RALINK_CHIP_MT7615E

if RALINK_WIFI_DRIVER

choice
	prompt "Choose First WiFi Interface"

	config RALINK_FIRST_IF_MT7615E
	bool "MT7615E"
	select RALINK_WIFI_MT_MAC
	select RALINK_MT_MAC
	select RALINK_CHIP_MT7615E

	config RALINK_FIRST_IF_MT7622
	bool "MT7622"
	select RALINK_WIFI_MT_MAC
	select RALINK_MT_MAC
	select RALINK_CHIP_MT7622

	config RALINK_FIRST_IF_MT7626
	bool "MT7626"
	select RALINK_WIFI_MT_MAC
	select RALINK_MT_MAC
	select RALINK_CHIP_MT7626

	config RALINK_FIRST_IF_NONE
	bool "None"
endchoice

choice
	prompt "Choose Second WiFi Interface"
	default RALINK_SECOND_IF_NONE if PACKAGE_kmod-mt7603e
	default RALINK_SECOND_IF_NONE if TARGET_ralink_mt7621_DEVICE_jcg_y2
	default RALINK_SECOND_IF_NONE if TARGET_ralink_mt7621_DEVICE_phicomm_k2p
	default RALINK_SECOND_IF_MT7615E

config RALINK_SECOND_IF_NONE
	bool "None"

config RALINK_SECOND_IF_MT7615E
	bool "MT7615E"
	select RALINK_WIFI_MT_MAC
	select RALINK_CHIP_MT7615E
	select RALINK_MULTI_INF_SUPPORT

endchoice

choice
	prompt "Choose Third WiFi Interface"
	config RALINK_THIRD_IF_NONE
	bool "None"

	config RALINK_THIRD_IF_MT7615E
	bool "MT7615E"
	select RALINK_WIFI_MT_MAC
	select RALINK_CHIP_MT7615E
	select RALINK_MULTI_INF_SUPPORT

endchoice

config  RALINK_RT_FIRST_CARD
        int
        depends on ! RALINK_FIRST_IF_NONE
	default 7615 if RALINK_FIRST_IF_MT7615E
        default 7622 if RALINK_FIRST_IF_MT7622
        default 7626 if RALINK_FIRST_IF_MT7626

config  RALINK_RT_SECOND_CARD
        int
        depends on ! RALINK_SECOND_IF_NONE
        default 7615 if RALINK_SECOND_IF_MT7615E

config  RALINK_RT_THIRD_CARD
        int
        depends on ! RALINK_THIRD_IF_NONE
        default 7615 if RALINK_THIRD_IF_MT7615E

config  RALINK_RT_FIRST_IF_RF_OFFSET
        hex
        depends on ! RALINK_FIRST_IF_NONE
        default 0xc0000

config  RALINK_RT_SECOND_IF_RF_OFFSET
        hex
        depends on ! RALINK_SECOND_IF_NONE
        default 0xc8000

config  RALINK_RT_THIRD_IF_RF_OFFSET
        hex
        depends on ! RALINK_THIRD_IF_NONE
        default 0xd0000

config RALINK_MT_WIFI
	tristate "MT WIFI Driver"
	select RALINK_WIFI_BASIC_FUNC if RALINK_MT_WIFI
	default y

config RALINK_MT_WIFI_PATH
	string
	depends on RALINK_MT_WIFI
	default "mt_wifi"

if RALINK_MT_WIFI
menu "WiFi Generic Feature Options"
choice
	prompt "EEPROM Type of 1st Card"
	depends on ! RALINK_FIRST_IF_NONE

	config RALINK_FIRST_IF_EEPROM_FLASH
	bool "FLASH"

	config RALINK_FIRST_IF_EEPROM_PROM
	bool "EEPROM"

	config RALINK_FIRST_IF_EEPROM_EFUSE
	bool "EFUSE"

endchoice

config RALINK_RT_FIRST_CARD_EEPROM
	string
	depends on ! RALINK_FIRST_IF_NONE
	default "prom" if RALINK_FIRST_IF_EEPROM_PROM
	default "efuse" if RALINK_FIRST_IF_EEPROM_EFUSE
	default "flash" if RALINK_FIRST_IF_EEPROM_FLASH

choice
	prompt "EEPROM Type of 2nd Card"
	depends on ! RALINK_SECOND_IF_NONE

	config RALINK_SECOND_IF_EEPROM_FLASH
	bool "FLASH"

	config RALINK_SECOND_IF_EEPROM_PROM
	bool "EEPROM"

	config RALINK_SECOND_IF_EEPROM_EFUSE
	bool "EFUSE"

endchoice

config RALINK_RT_SECOND_CARD_EEPROM
	string
	depends on ! RALINK_SECOND_IF_NONE
	default "prom" if RALINK_SECOND_IF_EEPROM_PROM
	default "efuse" if RALINK_SECOND_IF_EEPROM_EFUSE
	default "flash" if RALINK_SECOND_IF_EEPROM_FLASH

choice
		prompt "EEPROM Type of 3th Card"
		depends on ! RALINK_THIRD_IF_NONE

		config RALINK_THIRD_IF_EEPROM_FLASH
		bool "FLASH"

		config RALINK_THIRD_IF_EEPROM_PROM
		bool "EEPROM"

		config RALINK_THIRD_IF_EEPROM_EFUSE
		bool "EFUSE"

endchoice

config RALINK_RT_THIRD_CARD_EEPROM
		string
		depends on ! RALINK_THIRD_IF_NONE
		default "prom" if RALINK_THIRD_IF_EEPROM_PROM
		default "efuse" if RALINK_THIRD_IF_EEPROM_EFUSE
		default "flash" if RALINK_THIRD_IF_EEPROM_FLASH

config RALINK_MULTI_INF_SUPPORT
	bool
	default y if !RALINK_FIRST_IF_NONE && !RALINK_SECOND_IF_NONE

config RALINK_WIFI_BASIC_FUNC
	bool "Basic Functions"
	select RALINK_WIRELESS_EXT
	select RALINK_WEXT_SPY
	select RALINK_WEXT_PRIV

config RALINK_DOT11_N_SUPPORT
	bool "802.11n support"
	default y

config RALINK_DOT11_VHT_AC
	bool "802.11AC support"
	depends on RALINK_WIFI_DRIVER
	depends on RALINK_DOT11_N_SUPPORT
	default y

config RALINK_G_BAND_256QAM_SUPPORT
	bool "2.4G 256QAM support"
	depends on RALINK_WIFI_DRIVER
	depends on RALINK_DOT11_VHT_AC
        default y

config RALINK_BRCM_256QAM_SUPPORT
	bool "BRCM 2.4G 256QAM support"
	depends on RALINK_WIFI_DRIVER
	depends on RALINK_G_BAND_256QAM_SUPPORT
	default y

config RALINK_VHT_TXBF_2G_EPIGRAM_IE_SUPPORT
    bool "BRCM 2.4G VHT Sounding support"
	depends on RALINK_WIFI_DRIVER
	default y

config RALINK_TPC_SUPPORT
	bool "802.11h TPC Support"
	depends on RALINK_WIFI_DRIVER
	default y

config RALINK_ICAP_SUPPORT
	bool "ICAP Support"
	depends on RALINK_WIFI_DRIVER
	depends on RALINK_MT_AP_SUPPORT
	default y

config RALINK_SPECTRUM_SUPPORT
	bool "Wifi Spectrum Support"
	depends on RALINK_WIFI_DRIVER
	depends on RALINK_MT_AP_SUPPORT
	default y

config RALINK_BACKGROUND_SCAN_SUPPORT
	bool "Background Scan Support"
	depends on RALINK_WIFI_DRIVER
	default y

config RALINK_SMART_CARRIER_SENSE_SUPPORT
	bool "Smart Carrier Sense Support"
	depends on RALINK_WIFI_DRIVER
	default y

config RALINK_MT_DFS_SUPPORT
	bool "Dynamic Frequency Selection Support"
	depends on RALINK_WIFI_DRIVER
	default y

#config WFA_VHT_R2_PF
#	bool "WFA VHT R2 Plugfest"
#	depends on DOT11_VHT_AC
#	default n

config RALINK_HDR_TRANS_TX_SUPPORT
	bool "Tx Header Translation"
	depends on RALINK_CHIP_MT7615E || RALINK_CHIP_MT7622 || RALINK_CHIP_MT7626
	default y

config RALINK_HDR_TRANS_RX_SUPPORT
	bool "Rx Header Translation"
	depends on RALINK_CHIP_MT7615E || RALINK_CHIP_MT7622 || RALINK_CHIP_MT7626
	default y

config RALINK_DBDC_MODE
	bool "dbdc mode support"
	depends on RALINK_CHIP_MT7615E || RALINK_CHIP_MT7626
	select RALINK_MULTI_PROFILE_SUPPORT
	default y if TARGET_ralink_mt7621_DEVICE_jcg_y2
	default y if TARGET_ralink_mt7621_DEVICE_phicomm_k2p || TARGET_DEVICE_ralink_mt7621_DEVICE_phicomm_k2p
	default n

config RALINK_MULTI_PROFILE_SUPPORT
	bool "Multi Profile Support"
	depends on RALINK_DBDC_MODE
	default n

config RALINK_DEFAULT_5G_PROFILE
	bool "5G default profile for DBDC"
	depends on RALINK_DBDC_MODE
	depends on !PACKAGE_kmod-mt7615d_dbdc
	default y if TARGET_ralink_mt7621_DEVICE_jcg_y2
	default y if TARGET_ralink_mt7621_DEVICE_phicomm_k2p || TARGET_DEVICE_ralink_mt7621_DEVICE_phicomm_k2p
	default n

config RALINK_WSC_INCLUDED
	bool "WSC (WiFi Simple Config)"
	depends on RALINK_WIFI_DRIVER
	depends on RALINK_MT_AP_SUPPORT || RALINK_MT_STA_SUPPORT
	default y

config RALINK_WSC_V2_SUPPORT
	bool "WSC V2(WiFi Simple Config Version 2.0)"
	depends on RALINK_WIFI_DRIVER
	depends on RALINK_MT_AP_SUPPORT || RALINK_MT_STA_SUPPORT
	default y

config RALINK_DOT11W_PMF_SUPPORT
	bool "PMF"
	depends on RALINK_WIFI_DRIVER
	depends on RALINK_MT_AP_SUPPORT || RALINK_MT_STA_SUPPORT
	default y

config RALINK_TXBF_SUPPORT
	bool "Tx Bean Forming Support"
	depends on RALINK_WIFI_DRIVER
	default y

config RALINK_FAST_NAT_SUPPORT
       bool "Fast-NAT support"
#       depends on RA_HW_NAT_WIFI
       default n

config RALINK_WHNAT_SUPPORT
	tristate "Wifi Hardware NAT support"
	depends on RALINK_CHIP_MT7615E
	depends on RALINK_WLAN_HOOK
	depends on RALINK_FAST_NAT_SUPPORT
	default n

#config LLTD_SUPPORT
#	bool "LLTD (Link Layer Topology Discovery Protocol)"
#	depends on WIFI_DRIVER
#	depends on MT_AP_SUPPORT
#	default n

#config QOS_DLS_SUPPORT
#	bool "802.11e DLS ((Direct-Link Setup) Support"
#	depends on WIFI_DRIVER
#	depends on MT_AP_SUPPORT
#	default n

#config WAPI_SUPPORT
#	bool "WAPI Support"
#	depends on WIFI_DRIVER
#	default n

config RALINK_FTM_SUPPORT
	bool "FTM Support"
	depends on RALINK_WIFI_DRIVER
	select RALINK_PASSPOINT_R2
	default n

#config CARRIER_DETECTION_SUPPORT
#	bool "Carrier Detect"
#	depends on WIFI_DRIVER
#	default n

config RALINK_IGMP_SNOOP_SUPPORT
	bool "IGMP snooping"
	depends on RALINK_WIFI_DRIVER
	depends on RALINK_MT_AP_SUPPORT
	default y

#config BLOCK_NET_IF
#	bool "NETIF Block"
#	depends on WIFI_DRIVER
#	depends on MT_AP_SUPPORT
#	default n
#	help
#	Support Net interface block while Tx-Sw queue full

#config RATE_ADAPTION
#	bool "New Rate Adaptation support"
#	depends on WIFI_DRIVER
#	default y

#config NEW_RATE_ADAPT_SUPPORT
#	bool "Intelligent Rate Adaption"
#	depends on WIFI_DRIVER && RATE_ADAPTION
#	default y

#config AGS_SUPPORT
#	bool "Adaptive Group Switching"
#	depends on WIFI_DRIVER && RATE_ADAPTION
#	depends on MT_AP_SUPPORT || MT_STA_SUPPORT
#	default n

#config RATE_ADAPT_AGBS_SUPPORT
#	bool "Adaptive AGBS Mode"
#	depends on WIFI_DRIVER && RATE_ADAPTION
#	depends on MT_AP_SUPPORT || MT_STA_SUPPORT
#	default y

#config IDS_SUPPORT
#	bool "IDS (Intrusion Detection System) Support"
#	depends on WIFI_DRIVER
#	depends on MT_AP_SUPPORT
#	default n

#config WIFI_WORK_QUEUE
#	bool "Work Queue"
#	depends on WIFI_DRIVER
#	default n

#config WIFI_SKB_RECYCLE
#	bool "SKB Recycle(Linux)"
#	depends on WIFI_DRIVER
#	depends on MT_AP_SUPPORT
#	default n

config RALINK_RTMP_FLASH_SUPPORT
	bool "Flash Support"
	depends on RALINK_WIFI_DRIVER
	default y

config RALINK_PRE_CAL_TRX_SET1_SUPPORT
	bool "Calibration To Flash/BinFile Support"
	depends on RALINK_WIFI_DRIVER
	default y

config RALINK_RLM_CAL_CACHE_SUPPORT
	bool "RlmCalibrationCache Support"
	depends on RALINK_WIFI_DRIVER
	default y

config RALINK_PRE_CAL_TRX_SET2_SUPPORT
	bool "Pre-calibration to Flash Support"
	depends on RALINK_WIFI_DRIVER
	default y

config RALINK_RF_LOCKDOWN_SUPPORT
	bool "RF Lockdown Support"
	depends on RALINK_WIFI_DRIVER
	default n

config RALINK_LINK_TEST_SUPPORT
	bool "Link Test Support"
	depends on RALINK_WIFI_DRIVER
	default n

#config RALINK_LED_CONTROL_SUPPORT
#	bool "LED Support"
#	depends on RALINK_WIFI_DRIVER
#	depends on RALINK_MT_AP_SUPPORT
#	default n

config RALINK_ATE_SUPPORT
	bool "ATE/QA Support"
	depends on RALINK_WIFI_DRIVER
	default y

#config RALINK_MEMORY_OPTIMIZATION
#	bool "Memory Optimization"
#	depends on RALINK_WIFI_DRIVER
#	default n

config RALINK_PASSPOINT_R2
	bool "Passpoint Release-2 Support"
	depends on RALINK_WIFI_DRIVER
	select RALINK_DOT11W_PMF_SUPPORT
	depends on RALINK_MT_AP_SUPPORT
	default n

config RALINK_MBO_SUPPORT
        bool "MBO Support"
        depends on RALINK_WIFI_DRIVER
        select RALINK_INTERWORKING
        select RALINK_WNM_SUPPORT
        select RALINK_DOT11K_RRM_SUPPORT
        select RALINK_DOT11R_FT_SUPPORT
        select RALINK_DOT11W_PMF_SUPPORT
        default n

#config TRACE_TCP_PKT
#	   bool "TCP DATA/ACK packets trace log"
#	   depends on WIFI_DRIVER
#	   default n

config RALINK_UAPSD
	bool "UAPSD support"
	depends on RALINK_WIFI_DRIVER
	depends on RALINK_MT_AP_SUPPORT || RALINK_MT_STA_SUPPORT
	default y

config RALINK_TCP_RACK_SUPPORT
	bool "TCP Reduced ACK  support"
	depends on RALINK_WIFI_DRIVER
	default y

#### PA_LNA_Type choice

config RALINK_RED_SUPPORT
        bool "RED(Random Early Drop) support"
	depends on RALINK_WIFI_DRIVER
	depends on RALINK_MT_AP_SUPPORT || RALINK_MT_STA_SUPPORT
        default y

config RALINK_FQ_SCH_SUPPORT
        bool "Fair Queueing support"
        depends on RALINK_WIFI_DRIVER
        depends on RALINK_MT_AP_SUPPORT && RALINK_VOW_SUPPORT
        depends on RALINK_CHIP_MT7622
        default y

config RALINK_FDB_SUPPORT
       bool "FW Debug Port"
       depends on RALINK_WIFI_DRIVER
       default n

choice
        prompt "PA LNA Type of 1st Card"
		depends on ! RALINK_FIRST_IF_NONE

		config RALINK_FIRST_IF_IPAILNA
		bool "iPAiLNA"
		config RALINK_FIRST_IF_IPAELNA
		bool "iPAeLNA"
		config RALINK_FIRST_IF_EPAELNA
		bool "ePAeLNA"
#		config RALINK_FIRST_IF_EPAILNA
#		bool "ePAiLNA"
endchoice
choice
        prompt "PA LNA Type of 2nd Card"
		depends on ! RALINK_SECOND_IF_NONE

		config RALINK_SECOND_IF_IPAILNA
		bool "iPAiLNA"
		config RALINK_SECOND_IF_IPAELNA
		bool "iPAeLNA"
		config RALINK_SECOND_IF_EPAELNA
		bool "ePAeLNA"
#		config RALINK_SECOND_IF_EPAILNA
#		bool "ePAiLNA"
endchoice
choice
        prompt "PA LNA Type of 3rd Card"
		depends on ! RALINK_THIRD_IF_NONE

		config RALINK_THIRD_IF_EPAELNA
		bool "ePAeLNA"
		config RALINK_THIRD_IF_IPAILNA
		bool "iPAiLNA"
		config RALINK_THIRD_IF_IPAELNA
		bool "iPAeLNA"
#		config RALINK_THIRD_IF_EPAILNA
#		bool "ePAiLNA"
endchoice
#### PA_LNA_Type choice END

#
# Section for chip architectures
#
# "RLT MAC Support"
config RALINK_RLT_MAC
	bool
	depends on RALINK_WIFI_DRIVER
	default n

config RALINK_RLT_BBP
	bool

config RALINK_RLT_RF
	bool

# "RTMP MAC Support"
config RALINK_RTMP_MAC
	bool
	depends on RALINK_WIFI_DRIVER
	default n

config RALINK_RTMP_BBP
	bool

config RALINK_RTMP_RF
	bool

#
# Section for interfaces
#
config RALINK_RTMP_PCI_SUPPORT
	bool

config RALINK_RTMP_USB_SUPPORT
	bool

config RALINK_RTMP_RBUS_SUPPORT
	bool

endmenu

menu "WiFi Operation Modes"

config RALINK_WIFI_MODE_AP
	tristate "AP"
	default y
	select RALINK_MT_AP_SUPPORT

config RALINK_WIFI_MODE_STA
	tristate "STA"
	select RALINK_MT_STA_SUPPORT

config RALINK_WIFI_MODE_BOTH
	tristate "APSTA"
	select RALINK_MT_AP_SUPPORT
	select RALINK_MT_STA_SUPPORT


config RALINK_MT_AP_SUPPORT
	tristate "Ralink RT2860 802.11n AP support"
#	depends on NET_RADIO
	select RALINK_WIRELESS_EXT
	select RALINK_WEXT_SPY
	select RALINK_WEXT_PRIV
	default y

config RALINK_WDS_SUPPORT
	bool "WDS"
	depends on RALINK_MT_AP_SUPPORT
	default y

config RALINK_MBSS_SUPPORT
	bool "MBSSID"
	depends on RALINK_MT_AP_SUPPORT
	default y

#config NEW_MBSSID_MODE
#	bool "New MBSSID MODE"
#	depends on MT_AP_SUPPORT && MBSS_SUPPORT
#	depends on RALINK_RT3883 || RALINK_RT3352 || RALINK_RT5350 || RALINK_RT6352 || RALINK_MT7620
#	default y

#config ENHANCE_NEW_MBSSID_MODE
#	bool "Enhanced MBSSID mode"
#	depends on NEW_MBSSID_MODE
#	default y

config RALINK_APCLI_SUPPORT
	bool "AP-Client Support"
	depends on RALINK_MT_AP_SUPPORT
	default y

config RALINK_APCLI_CERT_SUPPORT
	bool "AP-Client TGn Cert Support"
	depends on RALINK_MT_AP_SUPPORT
	depends on RALINK_APCLI_SUPPORT
        default n

config RALINK_MAC_REPEATER_SUPPORT
	bool "MAC Repeater Support"
	depends on RALINK_MT_AP_SUPPORT
	depends on RALINK_APCLI_SUPPORT
	depends on RALINK_RALINK_RT6352 || RALINK_RALINK_MT7620 || RALINK_RALINK_MT7603E || RALINK_MT_AP_SUPPORT
	default y

config RALINK_MWDS
    bool "Mixed WDS(MWDS)"
    depends on RALINK_MT_AP_SUPPORT
    select RALINK_APCLI_SUPPORT
    default n

config RALINK_MUMIMO_SUPPORT
	bool "MU-MIMO Support"
	depends on RALINK_WIFI_DRIVER
	select RALINK_MU_RA_SUPPORT
	default y

config RALINK_MU_RA_SUPPORT
  	bool "MU-RGA Support"
  	depends on RALINK_MUMIMO_SUPPORT

config RALINK_DOT11R_FT_SUPPORT
	bool "802.11r Fast BSS Transition"
	depends on RALINK_MT_AP_SUPPORT
	default n

config RALINK_DOT11K_RRM_SUPPORT
	bool "802.11k Radio Resource Management"
	depends on RALINK_MT_AP_SUPPORT
	default n

#config SNIFFER_SUPPORT
#	bool "SNIFFER"
#	depends on MT_AP_SUPPORT
#	default n

config RALINK_CFG80211_SUPPORT
	bool "CFG80211"
	depends on RALINK_MT_AP_SUPPORT
	default n

config RALINK_DSCP_PRI_SUPPORT
	bool "Dscp Priority Mapping Support"
	depends on RALINK_MT_AP_SUPPORT
	default n

config RALINK_CON_WPS_SUPPORT
	bool "Concurrent WPS Support"
	depends on RALINK_MT_AP_SUPPORT
	depends on RALINK_APCLI_SUPPORT
	depends on RALINK_WSC_INCLUDED
	depends on RALINK_WSC_V2_SUPPORT
#	depends on RALINK_MULTI_INF_SUPPORT
	default n

#config LLTD_SUPPORT
#	bool "LLTD (Link Layer Topology Discovery Protocol)"
#	depends on MT_AP_SUPPORT

#config COC_SUPPORT
#	bool "CoC Support"
#	depends on MT_AP_SUPPORT
#	default n

#config  RT2860V2_SNMP
#	bool "Net-SNMP Support"
#	depends on MT_AP_SUPPORT

config RALINK_MCAST_RATE_SPECIFIC
	bool "User specific tx rate of mcast pkt"
	depends on RALINK_MT_AP_SUPPORT
	default y

#config EXT_BUILD_CHANNEL_LIST
#	bool "Extension Channel List"
#	depends on MT_AP_SUPPORT

#config AUTO_CH_SELECT_ENHANCE
#	bool "Auto Channel Selection Enhancement"
#	depends on MT_AP_SUPPORT

config RALINK_VOW_SUPPORT
	bool "MediaAir(VOW) support"
	depends on RALINK_MT_AP_SUPPORT
	default y

#config AIRPLAY_SUPPORT
#	bool "AIRPLAY Support"
#	depends on MT_AP_SUPPORT
#	default n

config RALINK_BAND_STEERING
	bool "Band Steering"
	depends on RALINK_MT_AP_SUPPORT
	default y

config RALINK_LED_CONTROL_SUPPORT
	bool "LED Control Support"
	default y

config RALINK_WLAN_HOOK
       bool "WLAN hook Support"
       depends on RALINK_WIFI_DRIVER
       default n

config RALINK_RADIUS_ACCOUNTING_SUPPORT
	bool "Radius Accounting Support"
	depends on RALINK_MT_AP_SUPPORT
	default n

config RALINK_GREENAP_SUPPORT
	bool "GreenAP Support"
	depends on RALINK_MT_AP_SUPPORT
	default n

config RALINK_PCIE_ASPM_DYM_CTRL_SUPPORT
	bool "Pcie Aspm Dynamic Control Support"
	depends on RALINK_MT_AP_SUPPORT
	default y

config RALINK_COEX_SUPPORT
	bool "Coex Support"
	depends on RALINK_MT_AP_SUPPORT
	default n

config RALINK_EASY_SETUP_SUPPORT
	bool "Whole Home Coverage - Easy Setup"
	depends on RALINK_MT_AP_SUPPORT
	default n

config RALINK_EVENT_NOTIFIER_SUPPORT
	bool "Whole Home Coverage - Event Notifier"
	depends on RALINK_MT_AP_SUPPORT
	default n

config RALINK_AIR_MONITOR
        bool "Air Monitor"
        depends on RALINK_MT_AP_SUPPORT
        default n

config RALINK_WNM_SUPPORT
        bool "802.11v WNM Support"
        depends on RALINK_MT_AP_SUPPORT
        default n

config RALINK_INTERWORKING
        bool "802.11u Interworking"
        depends on RALINK_MT_AP_SUPPORT
        default n

#config ROAMING_ENHANCE_SUPPORT
#	bool "Roaming Enhance Support"
#	depends on MT_AP_SUPPORT
#	depends on APCLI_SUPPORT
#	default n

config RALINK_LINUX_NET_TXQ_SUPPORT
	bool "NET TX Queue Support"
	default y

#config WIFI_FWD_SUPPORT
#        bool "WiFi Forwarding Support"
#        default n

endmenu

endif

config RALINK_WIFI_MT_MAC
	bool
	default y
	depends on RALINK_MT_WIFI

if RALINK_WIFI_RLT_MAC
	config RALINK_RLT_MAC
	bool
	default y
endif

if RALINK_WIFI_RTMP_MAC
	config RALINK_RTMP_MAC
		bool
		default y
endif

if RALINK_WIFI_MT_MAC
	config RALINK_MT_MAC
		bool
		default y

	config RALINK_CHIP_MT7603E
		bool
		default n

	config RALINK_CHIP_MT7615E
		bool
		default n

	config RALINK_CHIP_MT7622
		bool
		default n

	config RALINK_CHIP_MT7663E
		bool
		default n

	config RALINK_CHIP_MT7626
		bool
		default n
endif

if RALINK_CHIP_MT7615E || RALINK_CHIP_MT7622 || RALINK_CHIP_MT7626
	config RALINK_MT_MAC
		bool
		default y
		select RALINK_RATE_ADAPTION
		select RALINK_RATE_ADAPT_AGBS_SUPPORT
		select RALINK_DOT11_N_SUPPORT
		select RALINK_DOT11_VHT_AC
		select RALINK_HDR_TRANS_TX_SUPPORT
		select RALINK_HDR_TRANS_RX_SUPPORT
endif

endif #RALINK_WIFI_DRIVER#
endif #PACKAGE_kmod-mt7615d#
```
